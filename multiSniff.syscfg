/**
 * @cliArgs --board "/ti/boards/LP_CC2652RB" --rtos "tirtos7" --product "simplelink_cc13xx_cc26xx_sdk@6.30.01.03"
 * @versions {"tool":"1.14.0+2667"}
 */

/**
 * Import the modules used in this configuration.
 */
const custom    = scripting.addModule("/ti/devices/radioconfig/custom");
const GPIO      = scripting.addModule("/ti/drivers/GPIO");
const GPIO1     = GPIO.addInstance();
const GPIO2     = GPIO.addInstance();
const GPIO3     = GPIO.addInstance();
const GPIO4     = GPIO.addInstance();
const I2C       = scripting.addModule("/ti/drivers/I2C", {}, false);
const I2C1      = I2C.addInstance();
const Power     = scripting.addModule("/ti/drivers/Power");
const SPI       = scripting.addModule("/ti/drivers/SPI", {}, false);
const SPI1      = SPI.addInstance();
const Settings  = scripting.addModule("/ti/posix/tirtos/Settings");
const BIOS      = scripting.addModule("/ti/sysbios/BIOS");
const Event     = scripting.addModule("/ti/sysbios/knl/Event");
const Idle      = scripting.addModule("/ti/sysbios/knl/Idle", {}, false);
const Idle2     = Idle.addInstance();
const Mailbox   = scripting.addModule("/ti/sysbios/knl/Mailbox");
const Error     = scripting.addModule("/ti/sysbios/runtime/Error");
const System    = scripting.addModule("/ti/sysbios/runtime/System");
const Timestamp = scripting.addModule("/ti/sysbios/runtime/Timestamp");

/**
 * Write custom configuration values to the imported modules.
 */
custom.ble                                                   = ["bt5le1m"];
custom.ieee                                                  = ["ieee154"];
custom.radioConfigbt5le1m.$name                              = "ti_devices_radioconfig_settings_ble0";
custom.radioConfigbt5le1m.frequency                          = 2402;
custom.radioConfigbt5le1m.codeExportConfig.$name             = "ti_devices_radioconfig_code_export_param0";
custom.radioConfigbt5le1m.codeExportConfig.symGenMethod      = "Custom";
custom.radioConfigbt5le1m.codeExportConfig.cmdBle5RadioSetup = "RFCMD_bleRadioSetup";
custom.radioConfigbt5le1m.codeExportConfig.cmdList_ble       = ["cmdBle5GenericRx","cmdBle5RadioSetup","cmdFs"];
custom.radioConfigbt5le1m.codeExportConfig.cmdFs             = "RFCMD_bleFrequencySynthesizer";
custom.radioConfigbt5le1m.codeExportConfig.cmdBle5GenericRx  = "RFCMD_bleGenericRX";
custom.radioConfigbt5le1m.codeExportConfig.rfMode            = "RFCMD_bleModeObject";
custom.radioConfigbt5le1m.codeExportConfig.txPower           = "ble_txPowerTable";
custom.radioConfigbt5le1m.codeExportConfig.txPowerSize       = "BLE_TX_POWER_TABLE_SIZE";
custom.radioConfigbt5le1m.codeExportConfig.overrides         = "ble_pOverrides";
custom.radioConfigieee154.$name                              = "ti_devices_radioconfig_settings_ieee_15_40";
custom.radioConfigieee154.codeExportConfig.$name             = "ti_devices_radioconfig_code_export_param1";
custom.radioConfigieee154.codeExportConfig.symGenMethod      = "Custom";
custom.radioConfigieee154.codeExportConfig.cmdFs             = "RFCMD_ieeeFrequencySynthesizer";
custom.radioConfigieee154.codeExportConfig.cmdIeeeTx         = "RFCMD_ieeeTX";
custom.radioConfigieee154.codeExportConfig.cmdIeeeRx         = "RFCMD_ieeeRX";
custom.radioConfigieee154.codeExportConfig.rfMode            = "RFCMD_ieeeModeObject";
custom.radioConfigieee154.codeExportConfig.txPower           = "ieee_txPowerTable";
custom.radioConfigieee154.codeExportConfig.txPowerSize       = "IEEE_TX_POWER_TABLE_SIZE";
custom.radioConfigieee154.codeExportConfig.overrides         = "ieee_pOverrides";
custom.radioConfigieee154.codeExportConfig.cmdRadioSetup     = "RFCMD_ieeeRadioSetup";

GPIO1.$hardware = system.deviceData.board.components.LED_RED;
GPIO1.$name     = "CONFIG_GPIO_LED_0";

GPIO2.$name           = "CONFIG_GPIO_W5500_RESET";
GPIO2.gpioPin.$assign = "boosterpack.23";

GPIO3.$name           = "CONFIG_GPIO_W5500_CS";
GPIO3.gpioPin.$assign = "boosterpack.24";

GPIO4.$name           = "CONFIG_GPIO_W5500_INT";
GPIO4.gpioPin.$assign = "boosterpack.5";

I2C1.$name              = "CONFIG_I2C";
I2C1.i2c.sdaPin.$assign = "boosterpack.32";
I2C1.i2c.sclPin.$assign = "boosterpack.11";

const CCFG              = scripting.addModule("/ti/devices/CCFG", {}, false);
CCFG.ccfgTemplate.$name = "ti_devices_CCFG_CCFGCC26XXTemplate0";

SPI1.$name = "CONFIG_SPI_0";

BIOS.assertsEnabled = false;
BIOS.heapBaseAddr   = "__primary_heap_start__";
BIOS.heapEndAddr    = "__primary_heap_end__";

const Hwi           = scripting.addModule("/ti/sysbios/family/arm/m3/Hwi", {}, false);
Hwi.enableException = false;

const Clock      = scripting.addModule("/ti/sysbios/knl/Clock", {}, false);
Clock.tickPeriod = 10;

const Timer = scripting.addModule("/ti/sysbios/family/arm/cc26xx/Timer", {}, false);

Idle2.$name   = "powerIdle";
Idle2.idleFxn = "Power_idleFunc";

const Semaphore            = scripting.addModule("/ti/sysbios/knl/Semaphore", {}, false);
Semaphore.supportsPriority = false;

const Swi         = scripting.addModule("/ti/sysbios/knl/Swi", {}, false);
Swi.numPriorities = 6;

const Task             = scripting.addModule("/ti/sysbios/knl/Task", {}, false);
Task.checkStackFlag    = false;
Task.defaultStackSize  = 512;
Task.idleTaskStackSize = 512;
Task.numPriorities     = 6;

System.abortFxn        = "System_abortSpin";
System.exitFxn         = "System_exitSpin";
System.extendedFormats = "%f";

/**
 * Pinmux solution for unlocked pins/peripherals. This ensures that minor changes to the automatic solver in a future
 * version of the tool will not impact the pinmux you originally saw.  These lines can be completely deleted in order to
 * re-solve from scratch.
 */
GPIO1.gpioPin.$suggestSolution         = "boosterpack.39";
I2C1.i2c.$suggestSolution              = "I2C0";
SPI1.spi.$suggestSolution              = "SSI0";
SPI1.spi.sclkPin.$suggestSolution      = "boosterpack.19";
SPI1.spi.misoPin.$suggestSolution      = "boosterpack.30";
SPI1.spi.mosiPin.$suggestSolution      = "boosterpack.29";
SPI1.spi.dmaRxChannel.$suggestSolution = "DMA_CH3";
SPI1.spi.dmaTxChannel.$suggestSolution = "DMA_CH4";
Timer.rtc.$suggestSolution             = "RTC0";
